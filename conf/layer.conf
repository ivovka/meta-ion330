## conf/layer.conf
```bitbake
# We have a conf and classes directory, add to BBPATH
BBPATH .= ":${LAYERDIR}"

LICENSE_PATH += "${LAYERDIR}/files/additional-licenses"

# We have a recipes directory, add to BBFILES
BBFILES += "${LAYERDIR}/recipes-*/*/*.bb \
	${LAYERDIR}/recipes-*/*/*.bbappend"

BBFILE_COLLECTIONS += "ion330"
BBFILE_PATTERN_ion330 := "^${LAYERDIR}/"
BBFILE_PRIORITY_ion330 = "6"

LAYERDEPENDS_ion330 = "intel"
```

## conf/machine/ion330.conf
```bitbake
#@TYPE: Machine
#@NAME: ion330

#@WEBTITLE: Intel Atom 330 Processor With NVidia ION graphic accelerator

#@DESCRIPTION: Machine configuration for nVidia ION 330 systems

PREFERRED_VERSION_linux-yocto ?= "4.8%"
DEFAULTTUNE ?= "atom"

require conf/machine/include/meta-intel.inc
require conf/machine/include/tune-atom.inc
require conf/machine/include/x86-base.inc
require conf/machine/include/intel-common-pkgarch.inc

TUNEVALID[atom] = "Enable atom specific processor optimizations"
TUNE_CCARGS .= "${@bb.utils.contains("TUNE_FEATURES", "atom", " -march=bonnell -mtune=bonnell -msse3 -mfpmath=sse", "", d)}"
AVAILTUNES += "atom"
TUNE_FEATURES_tune-atom = "${TUNE_FEATURES_tune-x86} atom"
BASE_LIB_tune-atom = "lib"
TUNE_PKGARCH_tune-atom = "atom"
PACKAGE_EXTRA_ARCHS_tune-atom = "${PACKAGE_EXTRA_ARCHS_tune-i586} atom"

MACHINE_FEATURES += "intel-ucode"

#XSERVER ?= "${XSERVER_X86_BASE} \
#           ${XSERVER_X86_EXT} \
#           ${XSERVER_X86_VESA} \
#           "
XSERVER = "xserver-xorg \
           xf86-video-nvidia \
           xf86-input-keyboard \
           xf86-input-evdev \
           "

PREFERRED_PROVIDER_virtual/libgl = "nvidia-display"
PREFERRED_PROVIDER_virtual/mesa = "mesa"
PREFERRED_PROVIDER_virtual/libgles1 = ""
PREFERRED_PROVIDER_virtual/libgles2 = ""
PREFERRED_PROVIDER_virtual/egl = "nvidia-display"
PREFERRED_PROVIDER_virtual/libvdpau = "nvidia-display"
APPEND += "video=vesafb vga=0x318"
```
